## arch/arm/configs/cm_ms013g_defconfig
```kconfig
CONFIG_MACH_MS01_EUR_3G=y
CONFIG_SEC_MS01_PROJECT=y

CONFIG_FB_MSM_MDSS_SHARP_HD_PANEL=y
CONFIG_FB_MSM8x26_MDSS_CHECK_LCD_CONNECTION=n
CONFIG_LCD_CONNECTION_CHECK=y

CONFIG_MSM_VIBRATOR=y

CONFIG_TOUCHSCREEN_ZINITIX_BT531=y

CONFIG_SENSORS_HSCDTD008A=y
CONFIG_SENSORS_BMA254=y
CONFIG_BMA254_SMART_ALERT=y
CONFIG_SENSORS_GP2A030A=y
CONFIG_SENSORS_GP2A030A_PROX=y

CONFIG_ARCH_MSM8226_3G_WIFI=y
```

## arch/arm/configs/msm8226-sec_matissewifi_defconfig
```kconfig
CONFIG_SEC_MATISSE_PROJECT=y
CONFIG_SEC_MATISSEWIFI_COMMON=y
CONFIG_MACH_MATISSEWIFI_OPEN=y

CONFIG_FB_MSM_MDSS_TC_DSI2LVDS_WXGA_PANEL=y
CONFIG_TOUCHSCREEN_ATMEL_MXT1188S=y

CONFIG_IR_REMOCON_MC96FR116=y

CONFIG_ARCH_MSM8226_3G_WIFI=y
```

## arch/arm/hotplug/Kconfig
```kconfig
config INTELLI_PLUG
        bool "Enable intelli-plug cpu hotplug driver"
        default n
        help
          Generic Intelli-plug cpu hotplug driver for ARM SOCs

# Kconfig file for hotplugs

config INTELLI_PLUG
	bool "Enable intelli-plug cpu hotplug driver"
	default n
	help
Generic Intelli-plug cpu hotplug driver for ARM SOCs


config MSM_HOTPLUG
	bool "MSM hotplug driver"
	depends on HOTPLUG_CPU
	default y
	help
	  The MSM hotplug driver controls on-/offlining of additional cores based on current cpu load.

config ALUCARD_HOTPLUG
	bool "Enable alucard-hotplug cpu hotplug driver"
	default y
	help
Generic Alucard-hotplug cpu hotplug driver for ARM SOCs
```
